## main/Kconfig.projbuild
```kconfig
menu "improv-wifi BLE Example"
	config GPIO_RANGE_MAX
		int
		default 33 if IDF_TARGET_ESP32
		default 46 if IDF_TARGET_ESP32S2
		default 48 if IDF_TARGET_ESP32S3
		default 18 if IDF_TARGET_ESP32C2
		default 19 if IDF_TARGET_ESP32C3
		default 30 if IDF_TARGET_ESP32C6

	config IMPROV_WIFI_CAPABILITY_IDENTIFY
		bool "Device supports the identify command"
		default false

	config IMPROV_WIFI_AUTHENTICATION_BUTTON
		bool "Device supports authentication button"
		default false
		help
			Use a GPIO button for authentication.

	config IMPROV_WIFI_CONNECT_TIMEOUT
		int "WiFi provisioning timeout in seconds"
		range 3 60
		default 30
		help
			Timeout in seconds to wait for a successful WiFi connection after receiving the WiFi credentials.
			Valid range: 3-60

	config IMPROV_WIFI_PROVISIONED_URL
		string "Redirect URL after successful provisioning"
		default "https://github.com/zehnm/idf-improv-wifi-ble"
		help
			The URL to return after a successfull provisioning.

	menu "improv-wifi authorization configuration"
		visible if IMPROV_WIFI_AUTHENTICATION_BUTTON

		config IMPROV_WIFI_BUTTON_GPIO
			depends on IMPROV_WIFI_AUTHENTICATION_BUTTON
			int "Authentication button GPIO number"
			range 0 GPIO_RANGE_MAX
			default  9 if IDF_TARGET_ESP32C6
			default  0
			help
				GPIO number (IOxx) to use for the authentication button.
				Use the "Component config, IoT Button" settings to configure button press timings.

		config IMPROV_WIFI_AUTHENTICATION_TIMEOUT
			depends on IMPROV_WIFI_AUTHENTICATION_BUTTON
			int "Authorization timeout in seconds"
			range 1 1000
			default 60
			help
				If an Improv service has been authorized by a user interaction,
				the authorization should be automatically revoked after a timeout.

	endmenu

	menu "BLE DeviceInfo configuration"
		config BLE_DEVICE_INFO_MANUFACTURER_NAME
			string "Manufacturer name"
			default "Foobar Inc"
		config BLE_DEVICE_INFO_MODEL_NUMBER
			string "Model number"
			default "Prototype"
		config BLE_DEVICE_INFO_SERIAL_NUMBER
			string "Serial number"
			default "000001"
		config BLE_DEVICE_INFO_HARDWARE_REVISION
			string "Hardware revision"
			default "1.0"
		config BLE_DEVICE_INFO_FIRMWARE_REVISION
			string "Firmware revision"
			default "0.1.0"
	endmenu


endmenu
```
